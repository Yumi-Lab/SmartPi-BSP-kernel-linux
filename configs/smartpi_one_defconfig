## configs/smartpi_one_defconfig
```kconfig
# SmartPi One BSP — Allwinner H3 minimal
# Target: boots in ~5 seconds, ~15MB rootfs, WiFi + SSH ready

# Architecture
BR2_arm=y
BR2_cortex_a7=y
BR2_ARM_EABIHF=y
BR2_ARM_FPU_NEON_VFPV4=y

# Toolchain — musl for minimal footprint
BR2_TOOLCHAIN_BUILDROOT_MUSL=y

# Kernel — mainline 6.6 LTS
BR2_LINUX_KERNEL=y
BR2_LINUX_KERNEL_CUSTOM_VERSION=y
BR2_LINUX_KERNEL_CUSTOM_VERSION_VALUE="6.6.56"
BR2_LINUX_KERNEL_USE_DEFCONFIG=y
BR2_LINUX_KERNEL_DEFCONFIG="sunxi"
BR2_LINUX_KERNEL_DTS_SUPPORT=y
BR2_LINUX_KERNEL_INTREE_DTS_NAME="allwinner/sun8i-h3-nanopi-m1"
BR2_LINUX_KERNEL_INSTALL_TARGET=y

# U-Boot — nanopi_m1 base with SmartPi DRAM tuning
BR2_TARGET_UBOOT=y
BR2_TARGET_UBOOT_BUILD_SYSTEM_KCONFIG=y
BR2_TARGET_UBOOT_CUSTOM_VERSION=y
BR2_TARGET_UBOOT_CUSTOM_VERSION_VALUE="2023.01"
BR2_TARGET_UBOOT_BOARD_DEFCONFIG="nanopi_m1"
BR2_TARGET_UBOOT_CONFIG_FRAGMENT_FILES="board/smartpi-one/uboot.config.fragment"
BR2_TARGET_UBOOT_FORMAT_CUSTOM=y
BR2_TARGET_UBOOT_FORMAT_CUSTOM_NAME="u-boot-sunxi-with-spl.bin"

# Filesystem
BR2_TARGET_ROOTFS_EXT2=y
BR2_TARGET_ROOTFS_EXT2_4=y
BR2_TARGET_ROOTFS_EXT2_SIZE="256M"
BR2_ROOTFS_OVERLAY="board/smartpi-one/rootfs-overlay"
BR2_ROOTFS_POST_BUILD_SCRIPT="board/smartpi-one/post-build.sh"
BR2_ROOTFS_POST_IMAGE_SCRIPT="board/smartpi-one/post-image.sh"

# Image tools
BR2_PACKAGE_HOST_DOSFSTOOLS=y
BR2_PACKAGE_HOST_GENIMAGE=y
BR2_PACKAGE_HOST_MTOOLS=y

# Init — BusyBox init (no systemd)
BR2_INIT_BUSYBOX=y

# System
BR2_TARGET_GENERIC_HOSTNAME="smartpi"
BR2_TARGET_GENERIC_ISSUE="Welcome to SmartPi BSP"
BR2_TARGET_GENERIC_ROOT_PASSWD="yumi"
BR2_TARGET_GENERIC_GETTY_PORT="ttyS0"
BR2_TARGET_GENERIC_GETTY_BAUDRATE_115200=y
BR2_SYSTEM_DHCP="eth0"

# BusyBox — shell + core utils + udhcpc
BR2_PACKAGE_BUSYBOX=y

# WiFi — RTL8188EU
BR2_PACKAGE_WPA_SUPPLICANT=y
BR2_PACKAGE_WPA_SUPPLICANT_NL80211=y
BR2_PACKAGE_LINUX_FIRMWARE=y
BR2_PACKAGE_LINUX_FIRMWARE_RTL_87XX=y

# SSH — dropbear (lightweight)
BR2_PACKAGE_DROPBEAR=y
BR2_PACKAGE_DROPBEAR_CLIENT=y

# Networking
BR2_PACKAGE_IPROUTE2=y
BR2_PACKAGE_IPTABLES=y

# Utils
BR2_PACKAGE_NANO=y
BR2_PACKAGE_HTOP=y
```
